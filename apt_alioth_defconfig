## apt_alioth_defconfig
```kconfig
# ================================================================
# APTKernel — apt_alioth_defconfig
# Poco F3 (alioth) — Snapdragon 870 (SM8250-AC)
# Target: Maximum Performance + Smoothness
# ================================================================

# ── Base ─────────────────────────────────────────────────────────
CONFIG_ARCH_QCOM=y
CONFIG_ARCH_SM8250=y
CONFIG_ARCH_LAHAINA=y
CONFIG_VENDOR_NR_CPUS=8

# ── General ──────────────────────────────────────────────────────
CONFIG_LOCALVERSION="-APTKernel"
CONFIG_KERNEL_LZ4=y
CONFIG_DEFAULT_HOSTNAME="APTKernel"
CONFIG_SYSVIPC=y
CONFIG_POSIX_MQUEUE=y
CONFIG_NO_HZ_IDLE=y
CONFIG_HIGH_RES_TIMERS=y
CONFIG_PREEMPT=y
CONFIG_PREEMPT_COUNT=y

# ── Optimization Flags ───────────────────────────────────────────
CONFIG_CC_OPTIMIZE_FOR_PERFORMANCE=y
# CONFIG_CC_OPTIMIZE_FOR_SIZE is not set
CONFIG_ARCH_WANT_GENERAL_HUGETLB=y
CONFIG_GENERIC_FIND_FIRST_BIT=y

# ── Scheduler — WALT + EAS ───────────────────────────────────────
CONFIG_SCHED_WALT=y
CONFIG_WALT_BALANCE_UTIL_THRESHOLD=1140
CONFIG_ENERGY_MODEL=y
CONFIG_CPU_FREQ_GOV_SCHEDUTIL=y
CONFIG_CPU_FREQ_GOV_PERFORMANCE=y
CONFIG_CPU_FREQ_GOV_POWERSAVE=y
CONFIG_CPU_FREQ_GOV_CONSERVATIVE=y
CONFIG_CPU_FREQ_GOV_ONDEMAND=y
CONFIG_CPU_FREQ_GOV_INTERACTIVE=y
CONFIG_CPU_FREQ_DEFAULT_GOV_SCHEDUTIL=y
CONFIG_CPU_BOOST=y
CONFIG_CPU_FREQ_BOOST=y
CONFIG_SCHED_TUNE=y
CONFIG_CGROUP_SCHEDTUNE=y
CONFIG_DYNAMIC_STUNE_BOOST=y

# ── uclamp ───────────────────────────────────────────────────────
CONFIG_UCLAMP_TASK=y
CONFIG_UCLAMP_TASK_GROUP=y
CONFIG_UCLAMP_BUCKETS_COUNT=20

# ── SchedTune Nodes ──────────────────────────────────────────────
CONFIG_STUNE_ASSIST=y

# ── CPU Topology ─────────────────────────────────────────────────
CONFIG_NR_CPUS=8
CONFIG_HOTPLUG_CPU=y
CONFIG_HAVE_ARCH_THREAD_STRUCT_WHITELIST=y

# ── Input Boost ──────────────────────────────────────────────────
CONFIG_INPUT_BOOST=y
CONFIG_CPU_INPUT_BOOST=y
CONFIG_DEVFREQ_INPUT_BOOST=y
CONFIG_DYNAMIC_DEVFREQ_BOOST=y
CONFIG_GPU_INPUT_BOOST=y

# ── Memory Management ────────────────────────────────────────────
CONFIG_TRANSPARENT_HUGEPAGE=y
CONFIG_TRANSPARENT_HUGEPAGE_ALWAYS=y
CONFIG_COMPACTION=y
CONFIG_MIGRATION=y
CONFIG_BALLOON_COMPACTION=y
CONFIG_ZBUD=y
CONFIG_ZSMALLOC=y
CONFIG_ZPOOL=y
CONFIG_ZSWAP=y
CONFIG_KSM=y
CONFIG_DEFAULT_MMAP_MIN_ADDR=32768
CONFIG_CLEANCACHE=y
CONFIG_FRONTSWAP=y

# ── ZRAM ─────────────────────────────────────────────────────────
CONFIG_ZRAM=y
CONFIG_ZRAM_WRITEBACK=y
CONFIG_ZRAM_MEMORY_TRACKING=y
CONFIG_CRYPTO_LZ4=y
CONFIG_CRYPTO_LZ4HC=y
CONFIG_CRYPTO_ZSTD=y
CONFIG_CRYPTO_LZO=y
CONFIG_ZRAM_DEF_COMP_LZ4HC=y
CONFIG_ZRAM_DEF_COMP="lz4hc"

# ── SWAP ─────────────────────────────────────────────────────────
CONFIG_SWAP=y
CONFIG_MEMCG_SWAP=y
CONFIG_MEMCG_SWAP_ENABLED=y

# ── cgroups ──────────────────────────────────────────────────────
CONFIG_CGROUPS=y
CONFIG_CGROUP_FREEZER=y
CONFIG_CGROUP_DEVICE=y
CONFIG_CPUSETS=y
CONFIG_CGROUP_CPUACCT=y
CONFIG_CGROUP_SCHED=y
CONFIG_FAIR_GROUP_SCHED=y
CONFIG_RT_GROUP_SCHED=y
CONFIG_MEMCG=y
CONFIG_MEMCG_SWAP=y
CONFIG_BLK_CGROUP=y
CONFIG_CGROUP_WRITEBACK=y
CONFIG_CGROUP_PERF=y
CONFIG_CGROUP_BPF=y

# ── I/O Scheduler ────────────────────────────────────────────────
CONFIG_IOSCHED_BFQ=y
CONFIG_BFQ_GROUP_IOSCHED=y
CONFIG_IOSCHED_NOOP=y
CONFIG_IOSCHED_DEADLINE=y
CONFIG_IOSCHED_CFQ=y
CONFIG_DEFAULT_BFQ=y
CONFIG_DEFAULT_IOSCHED="bfq"
CONFIG_MQ_IOSCHED_KYBER=y
CONFIG_MQ_IOSCHED_DEADLINE=y

# ── Networking — TCP BBR ─────────────────────────────────────────
CONFIG_NET=y
CONFIG_TCP_CONG_ADVANCED=y
CONFIG_TCP_CONG_BBR=y
CONFIG_TCP_CONG_CUBIC=y
CONFIG_TCP_CONG_WESTWOOD=y
CONFIG_TCP_CONG_HTCP=y
CONFIG_DEFAULT_TCP_CONG="bbr"
CONFIG_NET_SCH_FQ=y
CONFIG_NET_SCH_FQ_CODEL=y
CONFIG_NET_SCH_SFQ=y
CONFIG_NET_SCH_HTB=y
CONFIG_NET_SCH_DEFAULT=y
CONFIG_DEFAULT_FQ=y

# ── Netfilter / TTL ──────────────────────────────────────────────
CONFIG_NETFILTER=y
CONFIG_IP_NF_IPTABLES=y
CONFIG_IP_NF_FILTER=y
CONFIG_IP_NF_NAT=y
CONFIG_IP_NF_MANGLE=y
CONFIG_NETFILTER_XT_MATCH_POLICY=y
CONFIG_IP_NF_TARGET_TTL=y
CONFIG_IP6_NF_TARGET_HL=y

# ── WireGuard ────────────────────────────────────────────────────
CONFIG_WIREGUARD=y
# CONFIG_WIREGUARD_DEBUG is not set

# ── FSync Toggle ─────────────────────────────────────────────────
CONFIG_FSYNC=y
CONFIG_ASYNC_FS=y

# ── GPU — Adreno ─────────────────────────────────────────────────
CONFIG_MSM_KGSL=y
CONFIG_ADRENO_SNAPSHOT_LEGACY=y
CONFIG_KGSL_PER_PROCESS_PAGE_TABLE=y
CONFIG_MSM_ADRENO_DEFAULT_GOVERNOR="msm-adreno-tz"
CONFIG_QCOM_KGSL=y

# ── Power Management ─────────────────────────────────────────────
CONFIG_PM=y
CONFIG_PM_SLEEP=y
CONFIG_PM_AUTOSLEEP=y
CONFIG_PM_WAKELOCKS=y
CONFIG_PM_WAKELOCKS_LIMIT=100
CONFIG_PM_DEBUG=y
CONFIG_CPU_IDLE=y
CONFIG_CPU_IDLE_GOV_MENU=y
CONFIG_CPU_IDLE_GOV_TEO=y
CONFIG_ARM_CPUIDLE=y
CONFIG_DEVFREQ_GOV_SIMPLE_ONDEMAND=y
CONFIG_DEVFREQ_GOV_PERFORMANCE=y
CONFIG_DEVFREQ_GOV_POWERSAVE=y
CONFIG_DEVFREQ_GOV_USERSPACE=y
CONFIG_DEVFREQ_GOV_PASSIVE=y

# ── Thermal ──────────────────────────────────────────────────────
CONFIG_THERMAL=y
CONFIG_THERMAL_OF=y
CONFIG_THERMAL_WRITABLE_TRIPS=y
CONFIG_QCOM_TSENS=y
CONFIG_THERMAL_GOV_STEP_WISE=y
CONFIG_THERMAL_GOV_FAIR_SHARE=y
CONFIG_THERMAL_GOV_USER_SPACE=y
CONFIG_THERMAL_GOV_POWER_ALLOCATOR=y
CONFIG_CPU_THERMAL=y
CONFIG_DEVFREQ_THERMAL=y

# ── Filesystem Support ───────────────────────────────────────────
CONFIG_EXT4_FS=y
CONFIG_EXT4_FS_ENCRYPTION=y
CONFIG_EXT4_ENCRYPTION=y
CONFIG_F2FS_FS=y
CONFIG_F2FS_FS_ENCRYPTION=y
CONFIG_F2FS_FS_SECURITY=y
CONFIG_F2FS_FS_XATTR=y
CONFIG_EROFS_FS=y
CONFIG_EROFS_FS_ZIP=y
CONFIG_EROFS_FS_ZIP_LZMA=y
CONFIG_NTFS_FS=y
CONFIG_EXFAT_FS=y
CONFIG_TMPFS=y
CONFIG_TMPFS_XATTR=y
CONFIG_OVERLAY_FS=y

# ── FuseBlk (for NTFS/exFAT) ────────────────────────────────────
CONFIG_FUSE_FS=y
CONFIG_CUSE=y

# ── Security ─────────────────────────────────────────────────────
CONFIG_SECURITY=y
CONFIG_SECURITY_SELINUX=y
CONFIG_SECURITY_SELINUX_BOOTPARAM=y
CONFIG_SECURITY_SELINUX_DEVELOP=y
CONFIG_DEFAULT_SECURITY_SELINUX=y

# ── KernelSU / SuSFS Support ─────────────────────────────────────
CONFIG_KSU=y
CONFIG_KSU_SUSFS=y
CONFIG_KSU_SUSFS_SUS_PATH=y
CONFIG_KSU_SUSFS_SUS_MOUNT=y
CONFIG_KSU_SUSFS_SUS_KSTAT=y
CONFIG_KSU_SUSFS_SUS_OVERLAYFS=y
CONFIG_KSU_SUSFS_TRY_UMOUNT=y
CONFIG_KSU_SUSFS_SPOOF_UNAME=y
CONFIG_KSU_SUSFS_ENABLE_LOG=y
CONFIG_KSU_SUSFS_HIDE_KSU_SUSFS_SYMBOLS=y

# ── Futex / FSync ────────────────────────────────────────────────
CONFIG_FUTEX=y
CONFIG_FUTEX_PI=y
CONFIG_APT_FSYNC=y

# ── Debugging (disabled for performance) ─────────────────────────
# CONFIG_DEBUG_KERNEL is not set
# CONFIG_SLUB_DEBUG is not set
# CONFIG_FTRACE is not set
# CONFIG_SCHEDSTATS is not set
# CONFIG_SCHED_DEBUG is not set
CONFIG_DYNAMIC_DEBUG=y

# ── Performance Extras ───────────────────────────────────────────
CONFIG_FUNCTION_ALIGNMENT=4
CONFIG_GENERIC_CPU_AUTOPROBE=y
CONFIG_ARCH_SUPPORTS_INT128=y

# ── Crypto ───────────────────────────────────────────────────────
CONFIG_CRYPTO_SHA1=y
CONFIG_CRYPTO_SHA256=y
CONFIG_CRYPTO_SHA512=y
CONFIG_CRYPTO_AES=y
CONFIG_CRYPTO_AES_ARM64=y
CONFIG_CRYPTO_AES_ARM64_CE=y
CONFIG_CRYPTO_SHA2_ARM64_CE=y
CONFIG_CRYPTO_AES_ARM64_BS=y
CONFIG_CRYPTO_GHASH_ARM64_CE=y
CONFIG_CRYPTO_CHACHA20_NEON=y
CONFIG_CRYPTO_POLY1305_NEON=y

# ── Franco Kernel Manager Compatible Nodes ───────────────────────
CONFIG_PROC_FS=y
CONFIG_SYSFS=y
CONFIG_MSM_PERFORMANCE=y
CONFIG_MSM_PERFORMANCE_MAX_FREQ=y
CONFIG_QCOM_PM=y

# ── Android Specific ─────────────────────────────────────────────
CONFIG_ANDROID=y
CONFIG_ANDROID_BINDER_IPC=y
CONFIG_ANDROID_BINDERFS=y
CONFIG_ANDROID_BINDER_DEVICES="binder,hwbinder,vndbinder"
CONFIG_SYNC=y
CONFIG_SW_SYNC=y
CONFIG_ION=y
CONFIG_ION_SYSTEM_HEAP=y
CONFIG_ASHMEM=y

# ── USB ──────────────────────────────────────────────────────────
CONFIG_USB=y
CONFIG_USB_XHCI_HCD=y
CONFIG_USB_DWCOTG=y

# ── BPF ──────────────────────────────────────────────────────────
CONFIG_BPF=y
CONFIG_BPF_SYSCALL=y
CONFIG_BPF_JIT=y
CONFIG_BPF_JIT_ALWAYS_ON=y
CONFIG_BPF_EVENTS=y

# ── QCOM Specifics ───────────────────────────────────────────────
CONFIG_QCOM_LOGBUF_BOOTLOG=y
CONFIG_QCOM_SCM=y
CONFIG_QCOM_COMMAND_DB=y
CONFIG_QCOM_RPMH=y
CONFIG_QCOM_CPR=y
CONFIG_QCOM_LLCC=y
CONFIG_QCOM_CACHE_DUMP=y
CONFIG_MSM_QDSP6_SSR=y
CONFIG_QCOM_EBI2=y
CONFIG_MSM_DMADEV=y
CONFIG_INTERCONNECT_QCOM=y

# ── Display / SurfaceFlinger Friendly ────────────────────────────
CONFIG_DRM=y
CONFIG_DRM_MSM=y
CONFIG_BACKLIGHT_LCD_SUPPORT=y
CONFIG_BACKLIGHT_CLASS_DEVICE=y

# ── Sound ────────────────────────────────────────────────────────
CONFIG_SOUND=y
CONFIG_SND=y
CONFIG_SND_SOC=y

# ── Touchscreen ──────────────────────────────────────────────────
CONFIG_INPUT_TOUCHSCREEN=y
CONFIG_TOUCHSCREEN_FTS=y
CONFIG_TOUCHSCREEN_XIAOMI_TOUCH=y

# ── Fingerprint ──────────────────────────────────────────────────
CONFIG_FINGERPRINT_FPC1020=y

# ── NFC ──────────────────────────────────────────────────────────
CONFIG_NFC=y
CONFIG_NFC_NCI=y

# ── Modules ──────────────────────────────────────────────────────
CONFIG_MODULES=y
CONFIG_MODULE_UNLOAD=y
CONFIG_MODULE_FORCE_UNLOAD=y
```
